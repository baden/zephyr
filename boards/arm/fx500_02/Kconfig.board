## boards/arm/fx500_02/Kconfig.board
```kconfig
# SPDX-License-Identifier: Apache-2.0
#
# Copyright (c) 2024 BaDen (baden.i.ua@gmail.com)

config BOARD_FXA500_02
	bool "Fenix Auto FXA500-02 Board"
	depends on SOC_M2354
```

## boards/arm/fx500_02/Kconfig.defconfig
```kconfig
# SPDX-License-Identifier: Apache-2.0
#
# Copyright (c) 2024 BaDen (baden.i.ua@gmail.com)

if BOARD_FXA500_02

config BOARD
	default "fxa500_02"
endif
```

## soc/arm/nuvoton_numaker/m2354/Kconfig.defconfig.m2354
```kconfig
# Copyright (c) 2023 Nuvoton Technology Corporation.
#
# SPDX-License-Identifier: Apache-2.0

if SOC_M2354

config NUM_IRQS
	default 115

endif # SOC_M2354
```

## soc/arm/nuvoton_numaker/m2354/Kconfig.defconfig.series
```kconfig
# Copyright (c) 2023 Nuvoton Technology Corporation.
#
# SPDX-License-Identifier: Apache-2.0

if SOC_SERIES_M2354

source "soc/arm/nuvoton_numaker/m2354/Kconfig.defconfig.m2354"

config SOC_SERIES
	default "m2354"

endif # SOC_SERIES_M2354
```

## soc/arm/nuvoton_numaker/m2354/Kconfig.series
```kconfig
# Copyright (c) 2023 Nuvoton Technology Corporation.
#
# SPDX-License-Identifier: Apache-2.0

config SOC_SERIES_M2354
	bool "Nuvoton M2354 Series MCU"
	select ARM
	select CPU_CORTEX_M23
	#select CPU_CORTEX_M_HAS_DWT
	#select CPU_HAS_FPU
	select CPU_CORTEX_M_HAS_VTOR
	select CPU_HAS_ARM_SAU
	select CPU_HAS_ARM_MPU
	select CORTEX_M_SYSTICK if SYS_CLOCK_EXISTS
	select CORTEX_M_HAS_SYSTICK
	select SOC_FAMILY_NUMAKER
	help
	  Enable support for Nuvoton M2354 MCU series
```

## soc/arm/nuvoton_numaker/m2354/Kconfig.soc
```kconfig
# Copyright (c) 2023 Nuvoton Technology Corporation.
#
# SPDX-License-Identifier: Apache-2.0

choice
	prompt "Nuvoton M2354 MCU Selection"
	depends on SOC_SERIES_M2354

config SOC_M2354
	bool "M2354"
	select HAS_NUMAKER_HAL

endchoice
```
